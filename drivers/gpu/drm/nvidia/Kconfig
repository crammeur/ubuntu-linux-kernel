## drivers/gpu/drm/nvidia/Kconfig
```kconfig
config DRM_NVIDIA
	bool "NVIDIA cards drivers"
	depends on DRM && PCI && MMU
	depends on DRM_NVIDIA_CARD
        select FW_LOADER
	select DRM_KMS_HELPER
	select DRM_TTM
	select BACKLIGHT_CLASS_DEVICE if DRM_NVIDIA_BACKLIGHT
	select BACKLIGHT_LCD_SUPPORT if DRM_NVIDIA_BACKLIGHT
	select ACPI_VIDEO if ACPI && X86 && BACKLIGHT_CLASS_DEVICE && INPUT
	select X86_PLATFORM_DEVICES if ACPI && X86
	select ACPI_WMI if ACPI && X86
	select MXM_WMI if ACPI && X86
	select POWER_SUPPLY
	# Similar to i915, we need to select ACPI_VIDEO and it's dependencies
	select BACKLIGHT_LCD_SUPPORT if ACPI && X86
	select BACKLIGHT_CLASS_DEVICE if ACPI && X86
	select INPUT if ACPI && X86
	select THERMAL if ACPI && X86
	select ACPI_VIDEO if ACPI && X86
	select DRM_VM
	help
	  Choose this option for NVIDIA support.

config DRM_NVIDIA_BACKLIGHT
	bool "Support for backlight control"
	depends on DRM_NVIDIA
	default y
	help
	  Say Y here if you want to control the backlight of your display
	  (e.g. a laptop panel).9
```

## drivers/gpu/vga/bbswitch/bbswitch-0.8/Kconfig
```kconfig
config VGA_BBSWITCH
	bool "bbswitch - GPU switching support (NVIDIA)"
	depends on X86
	depends on ACPI
	depends on PCI
	depends on VGA_SWITCHEROO
	select VGA_ARB
```
